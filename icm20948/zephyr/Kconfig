## icm20948/zephyr/Kconfig
```kconfig
# ICM20948 Six-Axis Motion Tracking device configuration options

# Copyright (c) 2020 TDK Invensense
# SPDX-License-Identifier: Apache-2.0

menuconfig ICM20948
	bool "ICM20948 Six-Axis Motion Tracking Device"
	depends on SPI
	help
	  Enable driver for ICM20948 SPI-based six-axis motion tracking device.

if ICM20948

choice
	prompt "Trigger mode"
	default ICM20948_TRIGGER_GLOBAL_THREAD
	help
	  Specify the type of triggering to be used by the driver.

config ICM20948_TRIGGER_NONE
	bool "No trigger"

config ICM20948_TRIGGER_GLOBAL_THREAD
	bool "Use global thread"
	depends on GPIO
	select ICM20948_TRIGGER

config ICM20948_TRIGGER_OWN_THREAD
	bool "Use own thread"
	depends on GPIO
	select ICM20948_TRIGGER


endchoice

config ICM20948_TRIGGER
	bool "enable trigger"

config ICM20948_THREAD_PRIORITY
	int "Thread priority"
	depends on ICM20948_TRIGGER_OWN_THREAD
	default 10
	help
	  Priority of thread used by the driver to handle interrupts.

config ICM20948_THREAD_STACK_SIZE
	int "Thread stack size"
	depends on ICM20948_TRIGGER_OWN_THREAD
	default 1024
	help
	  Stack size of thread used by the driver to handle interrupts.

endif # ICM20948
```
